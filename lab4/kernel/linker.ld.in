#define __LINKER__
#include "task.h"

SECTIONS
{
	. = 0x80000;
	__sp_address = .;
	.text : {
		*start.S.obj(.text)
		*(.text)
	}

	.data : {
		*(.data .data.*)
	}

	.rodata : {
		*(.rodata .rodata.*)
	}

	.bss : {
		. = ALIGN(16);
		__bss_start = .;
		*(.bss .bss.*)
		*(COMMON)
		. = ALIGN(16);
		__bss_end = .;
	}

	. = ALIGN(16);
	__user_stack_start = .;
	. = . + USER_STACK_RESERVED_SIZE;
	. = ALIGN(16);
	__kernel_stack_start = .;
	. = . + KERNEL_STACK_RESERVED_SIZE;
	. = ALIGN(16);	
}
