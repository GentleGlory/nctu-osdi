#define __LINKER__
#include "task.h"

SECTIONS
{
	. = 0xffff000000000000; // kernel space
	__kernel_virtual_base = .;
	. = __kernel_virtual_base + 0x80000; // kernel load address
	__el2_sp = .;
	__el1_sp = __el2_sp - 0x20000;
	__el0_sp = __el1_sp - 0x20000;
	__kernel_start = __el0_sp - 0x20000;
	.text : {
		*start.S.obj(.text)
		*(.text)
	}

	.data : {
		. = ALIGN(16);
		*(.data .data.*)
	}

	.rodata : {
		. = ALIGN(16);
		*(.rodata .rodata.*)
	}

	.bss : {
		. = ALIGN(16);
		__bss_start = .;
		*(.bss .bss.*)
		*(COMMON)
		. = ALIGN(16);
		__bss_end = .;
	}

	. = ALIGN(16);
	__user_stack_start = .;
	. = . + USER_STACK_RESERVED_SIZE;
	. = ALIGN(16);
	__kernel_stack_start = .;
	. = . + KERNEL_STACK_RESERVED_SIZE;
	. = ALIGN(16);

	. = ALIGN(0x1000);
	__id_map_pgd_start = .;
	. += 0x1000; /* 4KB */
	__id_map_pgd_end = .;

	. = ALIGN(0x1000);
	__id_map_pud_start = .;
	. += 0x1000;    /* 4KB */
	__id_map_pud_end = .;

	. = ALIGN(0x1000);
	__id_map_pmd_start = .;
	. += 0x2000;    /* 8KB */
	__id_map_pmd_end = .;
	
	. = ALIGN(0x1000);
	__kernel_end = .;
}
